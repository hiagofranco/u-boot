## drivers/ram/sophgo/Kconfig
```kconfig
config SPL_SOPHGO_CV180X_DDR
	bool "Sophgo CV180x DDR driver in SPL"
	depends on SPL_RAM && SOPHGO_CV1800B
	help
	  This enables the DDR2 controller and PHY initialization and
	  training for the Sophgo CV180x (CV1800B) SoC in SPL.
```
